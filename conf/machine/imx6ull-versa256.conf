## conf/machine/imx6ull-versa256.conf
```bitbake
#@TYPE: Machine
#@NAME: CALIXTO i.MX6ULL VERSA SOM
#@SOC: i.MX6ULL
#@DESCRIPTION: Machine configuration for CALIXTO i.MX6ULL VERSA SOM
#@MAINTAINER:  calixto systems 

MACHINEOVERRIDES =. "mx6:mx6ul:mx6ull:"

include conf/machine/include/imx-base.inc
include conf/machine/include/arm/armv7a/tune-cortexa7.inc

KERNEL_DEVICETREE = " \
    nxp/imx/imx6ull-calixto-versa.dtb \
"

PREFERRED_PROVIDER_virtual/bootloader = "u-boot-calixto-nxp"
PREFERRED_PROVIDER_virtual/kernel = "linux-calixto-nxp"
UBOOT_CONFIG = "sd"
UBOOT_CONFIG[sd] = "imx6ull_versa_256_sd_uboot_defconfig,sdcard"

IMAGE_INSTALL:append = " kernel kernel-devicetree"

UBOOT_MAKE_TARGET = "u-boot.imx"
UBOOT_SUFFIX = "imx"

IMX_KERNEL_CONFIG_AARCH32 = "imx6ull_calixto_default_defconfig"
KBUILD_DEFCONFIG:mx6-nxp-bsp= "${IMX_KERNEL_CONFIG_AARCH32}"


MACHINE_FEATURES += "wifi bluetooth optee bcm4339 bcm43455"
```
