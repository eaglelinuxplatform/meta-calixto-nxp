## conf/distro/include/fsl-imx-preferred-env.inc
```bitbake
# --Calixto Source-- 
PREFERRED_PROVIDER_virtual/bootloader = "u-boot-calixto-nxp"
PREFERRED_PROVIDER_virtual/kernel = "linux-calixto-nxp"

PREFERRED_PROVIDER_linux-imx-mfgtool = "linux-imx-mfgtool"

PREFERRED_VERSION_gstreamer1.0-plugins-base = "1.20.3.imx"
PREFERRED_VERSION_gstreamer1.0-plugins-bad  = "1.20.3.imx"
PREFERRED_VERSION_gstreamer1.0-plugins-good = "1.20.3.imx"
PREFERRED_VERSION_gstreamer1.0-plugins-good-qt = "1.20.3.imx"
PREFERRED_VERSION_gstreamer1.0              = "1.20.3.imx"

PREFERRED_VERSION_gstreamer1.0-plugins-base:mx8-nxp-bsp = "1.20.3.imx"
PREFERRED_VERSION_gstreamer1.0-plugins-bad:mx8-nxp-bsp  = "1.20.3.imx"
PREFERRED_VERSION_gstreamer1.0-plugins-good:mx8-nxp-bsp = "1.20.3.imx"
PREFERRED_VERSION_gstreamer1.0-plugins-good-qt:mx8-nxp-bsp = "1.20.3.imx"
PREFERRED_VERSION_gstreamer1.0-plugins-ugly:mx8-nxp-bsp = "1.20.%"
PREFERRED_VERSION_gstreamer1.0:mx8-nxp-bsp              = "1.20.3.imx"
PREFERRED_VERSION_gstreamer1.0-libav:mx8-nxp-bsp        = "1.20.%"
PREFERRED_VERSION_gstreamer1.0-rtsp-server:mx8-nxp-bsp  = "1.20.%"

PREFERRED_VERSION_opengl-es-cts:mx6-nxp-bsp = "3.2.4.0"
PREFERRED_VERSION_opengl-es-cts:mx7-nxp-bsp = "3.2.4.0"
PREFERRED_VERSION_opengl-es-cts:aarch64 = "3.2.8.0"

# Use systemd as default init manager
VIRTUAL-RUNTIME_init_manager = "systemd"
PREFERRED_PROVIDER_udev = "systemd"
PREFERRED_PROVIDER_udev-utils = "systemd"
DISTRO_FEATURES_BACKFILL_CONSIDERED = "sysvinit"
POKY_DEFAULT_DISTRO_FEATURES += " systemd"
```

## conf/layer.conf
```bitbake
# We have a conf and classes directory, add to BBPATH
BBPATH .= ":${LAYERDIR}"

# We have recipes-* directories, add to BBFILES
BBFILES += "${LAYERDIR}/recipes-*/*/*.bb \
            ${LAYERDIR}/recipes-*/*/*.bbappend"

BBFILE_COLLECTIONS += "meta-calixto-nxp"
BBFILE_PATTERN_meta-calixto-nxp = "^${LAYERDIR}/"
BBFILE_PRIORITY_meta-calixto-nxp = "8"

LAYERDEPENDS_meta-calixto-nxp = "core"
LAYERSERIES_COMPAT_meta-calixto-nxp = "kirkstone"
```

## conf/machine/create-calixto-image.inc
```bitbake
create_imx6ull_versa_image () {

CALIXTO_IMAGE_PATH_SDCARD="${DEPLOY_DIR}/../../../calixto-images/${MACHINE}/sdcard"

mkdir -p ${CALIXTO_IMAGE_PATH_SDCARD}
rm -rf ${CALIXTO_IMAGE_PATH_SDCARD}/*

cp -v ${DEPLOY_DIR_IMAGE}/u-boot.imx ${CALIXTO_IMAGE_PATH_SDCARD}/u-boot-dtb.imx

cp ${DEPLOY_DIR}/../../../sources/meta-calixto-nxp/recipes-bsp/imx6ull-versa-flasher/imx6ull-versa-flasher-0.1/create-sdcard-boot.sh ${CALIXTO_IMAGE_PATH_SDCARD}

}
```

## conf/machine/imx6ull-versa1024.conf
```bitbake
#@TYPE: Machine
#@NAME: imx6ull-versa1024
#@SOC : i.MX6ULL
#@DESCRIPTION: Machine configuration for system with imx6ull-versa som with 256MB/512MB/1024MB DDR.

MACHINEOVERRIDES =. "mx6:mx6ul:mx6ull:"

include conf/machine/include/calixto-imx-base.inc
include conf/machine/include/arm/armv7a/tune-cortexa7.inc

MACHINE_FEATURES += "wifi usbgadget usbhost vfat alsa"

MACHINE_EXTRA_RRECOMMENDS = "kernel-modules kernel-devicetree"

KERNEL_DEVICETREE = "imx6ull-calixto-versa1024.dtb"

UBOOT_MAKE_TARGET = "u-boot.imx"
UBOOT_SUFFIX = "imx"

MACHINE_ESSENTIAL_EXTRA_RDEPENDS += "kernel-image kernel-devicetree"
PREFERRED_PROVIDER_virtual/kernel ?= "linux-calixto-nxp"
PREFERRED_PROVIDER_virtual/bootloader = "u-boot-calixto-nxp"
PREFERRED_PROVIDER_u-boot = "u-boot-calixto-nxp"

KERNEL_IMAGETYPE = "zImage"

UBOOT_CONFIG ??= "sd ${@bb.utils.contains('MACHINE_FEATURES', 'optee', 'sd-optee', '', d)}"
UBOOT_CONFIG[sd] = "imx6ull_versa_1024_sd_uboot_defconfig,sdcard"

# UBOOT_MACHINE = "imx6ull_versa_1024_sd_uboot_defconfig"
```

## conf/machine/imx6ull-versa512.conf
```bitbake
#@TYPE: Machine
#@NAME: imx6ull-versa512
#@SOC : i.MX6ULL
#@DESCRIPTION: Machine configuration for system with imx6ull-versa som with 256MB/512MB/1024MB DDR.

MACHINEOVERRIDES =. "mx6:mx6ul:mx6ull:"

include conf/machine/include/calixto-imx-base.inc
include conf/machine/include/arm/armv7a/tune-cortexa7.inc

IMAGE_INSTALL:append = "imx6ull-versa-flasher"

MACHINE_FEATURES += "wifi usbgadget usbhost vfat alsa"
MACHINE_EXTRA_RRECOMMENDS = "kernel-modules kernel-devicetree"

KERNEL_DEVICETREE = "imx6ull-calixto-versa.dtb"
KERNEL_IMAGETYPE = "zImage"

MACHINE_ESSENTIAL_EXTRA_RDEPENDS += "kernel-image kernel-devicetree"
PREFERRED_PROVIDER_virtual/kernel ?= "linux-calixto-nxp"
PREFERRED_PROVIDER_virtual/bootloader = "u-boot-calixto-nxp"
PREFERRED_PROVIDER_u-boot = "u-boot-calixto-nxp"

UBOOT_MAKE_TARGET = "u-boot.imx"
UBOOT_SUFFIX = "imx"

UBOOT_CONFIG ??= "sd ${@bb.utils.contains('MACHINE_FEATURES', 'optee', 'sd-optee', '', d)}"
UBOOT_CONFIG[sd] = "imx6ull_versa_512_sd_uboot_defconfig,sdcard"

# UBOOT_MACHINE = "imx6ull_versa_512_sd_uboot_defconfig"
```

## conf/machine/imx93-calixto-versa_2gb.conf
```bitbake
#@TYPE: Machine
#@NAME: CALIXTO i.MX 93 VERSA Evaluation Kit with LPDDR4X 2GB           
#@SOC: i.MX93
#@DESCRIPTION: Machine configuration for CALIXTO i.MX 93 VERSA EVK with LPDDR4X 2GB               
#@MAINTAINER: Anzal N  <anzal.n@calixto.co.in>

MACHINEOVERRIDES =. "mx93:"

require conf/machine/include/imx93-calixto.inc

KERNEL_DEVICETREE_BASENAME = "imx93-calixto-versa"

KERNEL_DEVICETREE = " \
    freescale/${KERNEL_DEVICETREE_BASENAME}.dtb \
"

UBOOT_CONFIG_BASENAME = "imx93_calixto_versa"
PREFERRED_PROVIDER_virtual/bootloader = "u-boot-calixto-nxp"
PREFERRED_PROVIDER_virtual/kernel = "linux-calixto-nxp"
UBOOT_CONFIG ??= "sd"
UBOOT_CONFIG[sd]   = "${UBOOT_CONFIG_BASENAME}_2gb_defconfig,sdcard"


DDR_FIRMWARE_NAME = " \
     lpddr4_dmem_1d_v202201.bin \
     lpddr4_dmem_2d_v202201.bin \
     lpddr4_imem_1d_v202201.bin \
     lpddr4_imem_2d_v202201.bin \
"

IMXBOOT_TARGETS = "${@bb.utils.contains('UBOOT_CONFIG', 'ecc', '${IMXBOOT_TARGETS_ECC}', '${IMXBOOT_TARGETS_SD}', d)}"
```
